## drivers/servo/Kconfig
```kconfig
#
# Servomechanism devices
#

menuconfig SERVO
	bool "Servo devices"
	default n
	---help---
	  You'll have to say Y if you wish to use servo's connected to your 
	  board

if SERVO
config OMAP_SERVO
	depends on HAVE_PWM
	tristate "OMAP servomechanisms driver"
	default n
	---help---
	  Say yes if you want to rock- depends on PWM being available

endif # SERVO
```

## drivers/ultrasonic/Kconfig
```kconfig
#
# Ultrasonic blah bla blah
#

menuconfig ULTRASONIC
	tristate "Ultrasonic ranging devices"
	default n
	---help---
	  You'll have to say Y or M if you wish to use ultrasonic ranging device
	  board

if ULTRASONIC

config ULTRASONIC_HC_SR04
	tristate "HC SR04 Arduino ranging device"
	default n
	---help---
	  Say yes if you have HC_SR04 and want to use it

endif # ULTRASONIC
```
